## components/components/who_sdcard_fatfs/Kconfig
```kconfig
menu "SD Card FAT Filesystem"

    config SDCARD_MOUNT_POINT
        string "SD card mount point"
        default "/sdcard"
        help
            VFS mount point for the SD card FAT filesystem.

    config SDCARD_MOUNT_FORMAT_ON_FAIL
        bool "Format SD card if mount fails"
        default y
        help
            If enabled, the SD card will be formatted if mounting fails
            (e.g., first time use or corrupted filesystem).

    config SDCARD_SDMMC_WIDTH
        int "SDMMC bus width (1 or 4)"
        default 1
        range 1 4
        help
            SDMMC bus width. 1-bit mode uses CLK, CMD, D0 only.
            4-bit mode adds D1, D2, D3.

    config SDCARD_SDMMC_CLK_GPIO
        int "SDMMC CLK GPIO"
        default 43
        help
            GPIO pin for SDMMC clock signal.

    config SDCARD_SDMMC_CMD_GPIO
        int "SDMMC CMD GPIO"
        default 44
        help
            GPIO pin for SDMMC command signal.

    config SDCARD_SDMMC_D0_GPIO
        int "SDMMC D0 GPIO"
        default 39
        help
            GPIO pin for SDMMC data line 0.

    config SDCARD_SDMMC_D1_GPIO
        int "SDMMC D1 GPIO"
        default 40
        depends on SDCARD_SDMMC_WIDTH >= 4
        help
            GPIO pin for SDMMC data line 1 (4-bit mode only).

    config SDCARD_SDMMC_D2_GPIO
        int "SDMMC D2 GPIO"
        default 41
        depends on SDCARD_SDMMC_WIDTH >= 4
        help
            GPIO pin for SDMMC data line 2 (4-bit mode only).

    config SDCARD_SDMMC_D3_GPIO
        int "SDMMC D3 GPIO"
        default 42
        depends on SDCARD_SDMMC_WIDTH >= 4
        help
            GPIO pin for SDMMC data line 3 (4-bit mode only).

endmenu
```

## components/spi_lcd_touch/Kconfig
```kconfig
menu "SPI LCD Touch Configuration"

    config SPI_LCD_TOUCH_SCLK_GPIO
        int "SPI Clock GPIO"
        default 20
        help
            GPIO pin number for SPI clock signal.

    config SPI_LCD_TOUCH_MOSI_GPIO
        int "SPI MOSI GPIO"
        default 21
        help
            GPIO pin number for SPI Master Out Slave In signal.

    config SPI_LCD_TOUCH_MISO_GPIO
        int "SPI MISO GPIO"
        default 6
        help
            GPIO pin number for SPI Master In Slave Out signal.

    config SPI_LCD_TOUCH_LCD_DC_GPIO
        int "LCD DC GPIO"
        default 23
        help
            GPIO pin number for LCD Data/Command selection.

    config SPI_LCD_TOUCH_LCD_CS_GPIO
        int "LCD CS GPIO"
        default 4
        help
            GPIO pin number for LCD chip select.

    config SPI_LCD_TOUCH_LCD_RST_GPIO
        int "LCD Reset GPIO"
        default 26
        help
            GPIO pin number for LCD reset.

    config SPI_LCD_TOUCH_BK_LIGHT_GPIO
        int "Backlight GPIO"
        default 5
        help
            GPIO pin number for LCD backlight control.

    config SPI_LCD_TOUCH_H_RES
        int "LCD Horizontal Resolution"
        default 320
        help
            Horizontal resolution in pixels.

    config SPI_LCD_TOUCH_V_RES
        int "LCD Vertical Resolution"
        default 480
        help
            Vertical resolution in pixels.

    config SPI_LCD_TOUCH_PIXEL_CLOCK_HZ
        int "Pixel Clock (Hz)"
        default 10000000
        help
            LCD pixel clock frequency in Hz.

    config SPI_LCD_TOUCH_DRAW_BUF_LINES
        int "LVGL Draw Buffer Lines"
        default 20
        help
            Number of display lines per draw buffer.

    config SPI_LCD_TOUCH_TICK_PERIOD_MS
        int "LVGL Tick Period (ms)"
        default 2
        help
            LVGL tick timer period in milliseconds.

    config SPI_LCD_TOUCH_TASK_STACK_SIZE
        int "LVGL Task Stack Size"
        default 16384
        help
            Stack size for the LVGL task in bytes.

    config SPI_LCD_TOUCH_TASK_PRIORITY
        int "LVGL Task Priority"
        default 2
        help
            FreeRTOS task priority for the LVGL task.

    menu "Touch Panel"

        config SPI_LCD_TOUCH_ENABLED
            bool "Enable Touch Panel"
            default n
            help
                Enable this option if you wish to use display touch.

        choice SPI_LCD_TOUCH_CONTROLLER
            prompt "Touch Controller Model"
            depends on SPI_LCD_TOUCH_ENABLED
            default SPI_LCD_TOUCH_CONTROLLER_STMPE610
            help
                Select LCD touch controller model.

            config SPI_LCD_TOUCH_CONTROLLER_STMPE610
                bool "STMPE610"
                help
                    Touch controller STMPE610 connected via SPI.

            config SPI_LCD_TOUCH_CONTROLLER_XPT2046
                bool "XPT2046"
                help
                    Touch controller XPT2046 connected via SPI.
        endchoice

        config SPI_LCD_TOUCH_CS_GPIO
            int "Touch CS GPIO"
            default 3
            depends on SPI_LCD_TOUCH_ENABLED
            help
                GPIO pin number for touch controller chip select.

        config SPI_LCD_TOUCH_INT_GPIO
            int "Touch Interrupt GPIO"
            default 2
            depends on SPI_LCD_TOUCH_ENABLED
            help
                GPIO pin number for touch controller interrupt.

        config SPI_LCD_TOUCH_MIRROR_Y
            bool "Mirror Y axis"
            default y if SPI_LCD_TOUCH_CONTROLLER_XPT2046
            default n
            depends on SPI_LCD_TOUCH_ENABLED
            help
                Mirror the Y axis of touch coordinates.

    endmenu

endmenu
```

## sdkconfig.defaults
```kconfig
CONFIG_FATFS_VFS_FSTAT_BLKSIZE=4096

# PSRAM (required for camera frame buffers ~2.4MB)
CONFIG_SPIRAM=y

# WiFi + Web Server (via ESP-Hosted ESP32-C6)
# Note: CONFIG_ESP_WIFI_ENABLED must NOT be set for ESP32-P4 (no native WiFi)
# The esp_wifi_remote component handles WiFi through ESP-Hosted
CONFIG_APP_WIFI_ENABLED=y
CONFIG_APP_WIFI_SSID="myssid"
CONFIG_APP_WIFI_PASSWORD="mypassword"
CONFIG_APP_WIFI_MAX_RETRY=5

# WDT: enable but don't panic, don't check idle tasks (prevents periodic reset)
CONFIG_ESP_TASK_WDT_EN=y
CONFIG_ESP_TASK_WDT_INIT=y
# CONFIG_ESP_TASK_WDT_PANIC is not set
CONFIG_ESP_TASK_WDT_TIMEOUT_S=5
# CONFIG_ESP_TASK_WDT_CHECK_IDLE_TASK_CPU0 is not set
# CONFIG_ESP_TASK_WDT_CHECK_IDLE_TASK_CPU1 is not set

# Flash size (face detection models need large flash)
CONFIG_ESPTOOLPY_FLASHSIZE_16MB=y
CONFIG_ESPTOOLPY_FLASHSIZE="16MB"

# Custom partition table (4MB app partition for face detection models)
CONFIG_PARTITION_TABLE_CUSTOM=y
CONFIG_PARTITION_TABLE_CUSTOM_FILENAME="partitions.csv"

# SPI LCD Touch - XPT2046
CONFIG_SPI_LCD_TOUCH_ENABLED=y
CONFIG_SPI_LCD_TOUCH_CONTROLLER_XPT2046=y

# Enable Montserrat 18/20/28/48 fonts for vending machine UI
CONFIG_LV_FONT_MONTSERRAT_18=y
CONFIG_LV_FONT_MONTSERRAT_20=y
CONFIG_LV_FONT_MONTSERRAT_28=y
CONFIG_LV_FONT_MONTSERRAT_48=y

# Camera OV5647 (800x800 RAW8)
CONFIG_CAMERA_OV5647=y
CONFIG_EXAMPLE_MIPI_CSI_HRES_800=y
CONFIG_EXAMPLE_MIPI_CSI_VRES_800=y

# Face recognition feature model (for face ID matching)
CONFIG_FLASH_HUMAN_FACE_FEAT_MFN_S8_V1=y

# ESP-SR Speech Recognition
CONFIG_SR_VADN_VADNET1_MEDIUM=y
CONFIG_SR_WN_WN9_HILEXIN=y
CONFIG_SR_MN_CN_MULTINET7_QUANT=y
```

## sdkconfig.defaults.esp32p4
```kconfig
CONFIG_SLAVE_IDF_TARGET_ESP32C6=y
CONFIG_ESP_HOSTED_CP_TARGET_ESP32C6=y
CONFIG_ESP_HOSTED_P4_DEV_BOARD_FUNC_BOARD=y
CONFIG_ESP_HOSTED_SDIO_HOST_INTERFACE=y

# ESP32-P4 has no native WiFi — disable esp_wifi native, use esp_wifi_remote
# CONFIG_ESP_WIFI_ENABLED is not set
CONFIG_ESP_WIFI_REMOTE_ENABLED=y

# Reduce SDIO mempool/queue memory usage
CONFIG_ESP_HOSTED_USE_MEMPOOL=n
CONFIG_ESP_HOSTED_SDIO_TX_Q_SIZE=10
CONFIG_ESP_HOSTED_SDIO_RX_Q_SIZE=10

CONFIG_WIFI_RMT_STATIC_RX_BUFFER_NUM=16
CONFIG_WIFI_RMT_DYNAMIC_RX_BUFFER_NUM=64
CONFIG_WIFI_RMT_DYNAMIC_TX_BUFFER_NUM=64
CONFIG_WIFI_RMT_AMPDU_TX_ENABLED=y
CONFIG_WIFI_RMT_TX_BA_WIN=32
CONFIG_WIFI_RMT_AMPDU_RX_ENABLED=y
CONFIG_WIFI_RMT_RX_BA_WIN=32

# ESP32-P4 revision (for ESP-SR compatibility)
CONFIG_ESP32P4_SELECTS_REV_LESS_V3=y

# Cache configuration (recommended for ESP32-P4)
CONFIG_CACHE_L2_CACHE_256KB=y
CONFIG_CACHE_L2_CACHE_LINE_128B=y

# I2S configuration for audio
CONFIG_I2S_ISR_IRAM_SAFE=y

# I2C - Skip legacy conflict check
CONFIG_I2C_SKIP_LEGACY_CONFLICT_CHECK=y

# Experimental features (required for some ESP32-P4 features)
CONFIG_IDF_EXPERIMENTAL_FEATURES=y
```
